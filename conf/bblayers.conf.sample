## conf/bblayers.conf.sample
```bitbake
# POKY_BBLAYERS_CONF_VERSION is increased each time build/conf/bblayers.conf
# changes incompatibly
POKY_BBLAYERS_CONF_VERSION = "2"

BBPATH = "${TOPDIR}"
BBFILES ?= ""

BBLAYERS ?= " \
  ##OEROOT##/layers/meta \
  ##OEROOT##/layers/meta-poky \
  ##OEROOT##/layers/meta-yocto-bsp \
  ##OEROOT##/layers/meta-openembedded/meta-oe \
  ##OEROOT##/layers/meta-openembedded/meta-initramfs \
  ##OEROOT##/layers/meta-openembedded/meta-networking \
  ##OEROOT##/layers/meta-openembedded/meta-python \
  ##OEROOT##/layers/meta-openembedded/meta-webserver \
  ##OEROOT##/layers/meta-raspberrypi \
  ##OEROOT##/layers/meta-qt5 \
  "
```
